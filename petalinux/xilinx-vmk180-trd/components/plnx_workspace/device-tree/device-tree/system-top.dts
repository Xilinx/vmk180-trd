/*
 * CAUTION: This file is automatically generated by Xilinx.
 * Version: XSCT 
 * Today is: Wed Feb  2 02:43:50 2022
 */


/dts-v1/;
#include "versal.dtsi"
#include "versal-vmk180-reva-x-ebm-01-reva.dtsi"
#include "versal-clk.dtsi"
#include "pcw.dtsi"
/ {
	chosen {
	};
	aliases {
		ethernet0 = &gem0;
		ethernet1 = &gem1;
		i2c0 = &i2c0;
		i2c1 = &i2c1;
		serial0 = &serial0;
	};
	memoryNOC_0: memory@0 {
		device_type = "memory";
		reg = <0x0 0x00000000 0x0 0x80000000>;
	};
};
#include "system-user.dtsi"
