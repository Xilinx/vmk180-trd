## petalinux/xilinx-vmk180-trd/project-spec/meta-vmk180-trd/conf/layer.conf
```bitbake
# We have a conf and classes directory, add to BBPATH
BBPATH .= ":${LAYERDIR}"

# We have recipes-* directories, add to BBFILES
BBFILES += " \
	${LAYERDIR}/recipes-*/*.bb \
	${LAYERDIR}/recipes-*/*.bbappend \
	${LAYERDIR}/recipes-*/*/*.bb \
	${LAYERDIR}/recipes-*/*/*.bbappend \
	"

BBFILE_COLLECTIONS += "meta-vmk180-trd"
BBFILE_PATTERN_meta-vmk180-trd = "^${LAYERDIR}/"
BBFILE_PRIORITY_meta-vmk180-trd = "6"

LAYERDEPENDS_meta-vmk180-trd = "petalinux jupyter-layer"

LAYERSERIES_COMPAT_meta-vmk180-trd = "zeus gatesgarth"
```
